## config/boards/shields/isotama/Kconfig.defconfig
```kconfig
if SHIELD_ISOTAMA_LEFT

config ZMK_KEYBOARD_NAME
    default "Isotama"

config ZMK_SPLIT_ROLE_CENTRAL
    default y

endif

if SHIELD_ISOTAMA_LEFT || SHIELD_ISOTAMA_RIGHT

config ZMK_SPLIT
    default y

endif
```

## config/boards/shields/isotama/Kconfig.shield
```kconfig
config SHIELD_ISOTAMA_LEFT
    def_bool $(shields_list_contains,isotama_left)

config SHIELD_ISOTAMA_RIGHT
    def_bool $(shields_list_contains,isotama_right)
```
